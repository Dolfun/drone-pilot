## components/wifi/Kconfig.projbuild
```kconfig
menu "Wi-Fi Manager"

    config ESP_WIFI_SSID
        string "Wi-Fi SSID"
        default "myssid"

    config ESP_WIFI_PASSWORD
        string "Wi-Fi Password"
        default "mypassword"

endmenu
```

## main/Kconfig.projbuild
```kconfig
menu "Drone Configuration"
    
    config ESP_MASTER_IP_ADDRESS
        string "Master's IP Address"
        default "1.1.1.1"

    config ESP_MASTER_PORT_NO
        string "Master's Port Number"
        default "13"

endmenu
```
